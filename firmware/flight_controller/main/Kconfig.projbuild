## firmware/flight_controller/main/Kconfig.projbuild
```kconfig
menu "HikoRobo Wi-Fi settings"

    config HIKOROBO_WIFI_SSID
        string "Ubuntu hotspot SSID (2.4 GHz)"
        default "HikoRobo_Lab"
        help
            SSID of the Ubuntu NetworkManager hotspot. Max 31 ASCII bytes in this demo.

    config HIKOROBO_WIFI_PASSWORD
        string "Ubuntu hotspot Wi-Fi password (8-63 characters)"
        default ""
        help
            Stored in the local sdkconfig and embedded in the firmware binary.
            DO NOT commit sdkconfig or share the built firmware publicly.

endmenu

menu "HikoRobo S.BUS monitor"

    config HIKOROBO_SBUS_MONITOR
        bool "Boot into the S.BUS USB monitor"
        default n
        help
            Read inverted S.BUS on XIAO D7 (GPIO44) and print raw channel
            values over USB. This bench mode replaces the normal flight
            controller startup, including its USB command server.

endmenu

menu "HikoRobo IMU telemetry"

    config HIKOROBO_IMU_STREAM_HOST
        string "Ground PC IPv4 address (UDP port 5006)"
        default ""
        help
            IPv4 address of the ground PC on the Wi-Fi network.
            An empty value disables IMU and S.BUS streaming.

endmenu
```
